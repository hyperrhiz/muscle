// Muscle Developer/Gemma, Adafruit + LED matrix backpack.  Counts reps
// reps on LED matrix.  Press reset button to display again.
// Your orientation may differ from mine... so may wish to play around with
// orientation readings for your adafruit sensor to align with your positionality

#define BRIGHTNESS   12 // 0=min, 15=max
#define I2C_ADDR   0x70 // Edit if backpack A0/A1 jumpers set

#include <Wire.h>
#include <avr/power.h>
#include <avr/sleep.h>
#include <Adafruit_MMA8451.h>
#include <Adafruit_Sensor.h>

Adafruit_MMA8451 xl = Adafruit_MMA8451();


static const uint8_t PROGMEM reorder[] = { // Column-reordering table
  0x00,0x40,0x20,0x60,0x10,0x50,0x30,0x70,0x08,0x48,0x28,0x68,0x18,0x58,0x38,0x78,
  0x04,0x44,0x24,0x64,0x14,0x54,0x34,0x74,0x0c,0x4c,0x2c,0x6c,0x1c,0x5c,0x3c,0x7c,
  0x02,0x42,0x22,0x62,0x12,0x52,0x32,0x72,0x0a,0x4a,0x2a,0x6a,0x1a,0x5a,0x3a,0x7a,
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  0x87,0xc7,0xa7,0xe7,0x97,0xd7,0xb7,0xf7,0x8f,0xcf,0xaf,0xef,0x9f,0xdf,0xbf,0xff };

void setup() {
pinMode(1,OUTPUT);
digitalWrite(1,LOW);
xl.begin();
xl.setRange(MMA8451_RANGE_2_G);

}

uint8_t output = 0;
uint8_t critRowArray[] = {0,128,192,224,240,248,252,254};
int criticalRow = 0;
uint8_t i=0;
void loop() {

 //
  Wire.beginTransmission(I2C_ADDR);
  Wire.write(0);
  for(uint8_t j=0; j<8; j++) {    // 8 rows...
    criticalRow = i/8;
    if(j < criticalRow) output = 255;
    else if(j == criticalRow) output = critRowArray[i%8];
    else output = 0;
    Wire.write(pgm_read_byte(&reorder[output]));
    Wire.write(0);
  }
  Wire.endTransmission();

//Accelerometer settings: feel free to toggle with the numbers to get a setting that works for your movement
  while(xl.getOrientation() != 2){}; // “while x is not this value (in my case, 2), wait”.
  delay(500);
  while(xl.getOrientation() != 6){}; //“while x is not this value (6), wait, but then increment i by one ”
  delay(500);
  i++;

  digitalWrite(1,HIGH); //then shock for 50ms, then go back to low state
  delay(50);
  digitalWrite(1,LOW);


}

